/***********************************************************************************************************************************
 **【购买链接】  魔女科技    https://demoboard.taobao.com
 **【更新分享】  Q群文件夹   887199504
 ***********************************************************************************************************************************
 **【文件名称】  hc08.c
 **【文件功能】  GPIO配置、AT指令配置、中断配置，及功能函数实现
 **【适用平台】  STM32F103 + 标准库v3.5 + keil5　+ HC-08
 **
 **
 **【重要说明】  本代码只适合HC-08, 不适合HC-05、HC-06, 
 **              HC-08：默认串口波特率9600
 **              HC-08：连接时，不需要密码；双方名称不一样亦可连接，只要一方为主机模式，另一方为从机模式
 **              HD-08: 连接后，数据发送为透传模式
 **              HC-08: 与手机蓝牙APP通信，APP必须支持BLE协议，另外，手机需打开位置功能(GPS), 否则很难搜索到HC-08设备，重要！重要！重要！
 **              HC-08: 只支持一对一通信，不支持多设备同时连接；
 **  
 **【移植说明】  1 - 在h文件中修改 HC08_ROLE的值，以配置本设备为主／从设备；
 **              2 - 在h文件中修改所用的USARTx端口；
 **              3 - 检查所用USARTx端口的中断函数，修改功能；
 **
 **
 **【更新记录】  2021-07-02  文件建立
 **              
 **    
************************************************************************************************************************************/
#include "HC08.h"





xHC08_TypeDef  xHC08;          // 声明为全局变量,方便记录信息、状态




// 本地MS粗略延时函数，减少移植时对外部文件依赖；
static void delayMS(u32 ms)
{
	
	u32 i;
    ms=ms*7000;                 // 大约7000个空循环为１ms
    for( i=0; i<ms; i++);    // 72MHz系统时钟下，多少个空循环约耗时1ms
}



/******************************************************************************
 * 函  数： HC08_Init
 * 功  能： 初始化串口的GPIO、通信参数配置、中断优先级，AT指令配置参数
 *          (8位数据、无校验、1个停止位)
 * 参  数： 无
 * 返回值： 无
 ******************************************************************************/  
void  HC08_Init(void)                                // 初始化串口及中断优先、AT参数配置级;
{      
    xHC08.flag_UARTConnect = 0;
    xHC08.flag_TargetConnect = 0;    
                
    USART2_Init(9600);     
    HC08_SendString("AT+CLEAR");  
    delayMS(30);                         
    if(HC08_ROLE == 1)    HC08_SendString("AT+ROLE=M");  // HC08配置成主机
    else                  HC08_SendString("AT+ROLE=S");  // HC08配置成从机                
                
    printf("蓝牙模块HC-08         配置完成\r\n");
}                



/******************************************************************************
 * 函  数： HC08_SendData
 * 功  能： 发送指定长度数据
 *    
 * 参  数： uint8_t* dataBuf   需要发送的数据缓冲区地址
 *          uint16_t cnt       需要发送的字节数量
 * 返回值： 无
 ******************************************************************************/  
void  HC08_SendData(uint8_t* dataBuf, uint16_t cnt)  // 发送指定长度的数据;
{
    while(cnt--)
    {	
        while((HC08_UARTx->SR & 0X40)==0); // 等待上一次串口数据发送完成
        HC08_UARTx->DR = *dataBuf;          // 写DR,串口将的发送数据 
        dataBuf++;
			
    }
}



/******************************************************************************
 * 函  数： HC08_SendString
 * 功  能： 发送字符串、指令
 *          注意：不发送字符串的结尾字符'\0', 即０
 * 参  数： uint8_t* strTemp   需要发送的数据缓冲区地址
 * 返回值： 无
 ******************************************************************************/  
void  HC08_SendString(char* strTemp)           // 发送字符串
{
    HC08_SendData((uint8_t *)strTemp, strlen(strTemp));                  
}


